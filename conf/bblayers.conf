## conf/bblayers.conf
```bitbake
# POKY_BBLAYERS_CONF_VERSION is increased each time build/conf/bblayers.conf
# changes incompatibly
POKY_BBLAYERS_CONF_VERSION = "2"

BBPATH = "${TOPDIR}"
BBFILES ?= ""

BBLAYERS ?= " \
  /home/fallal/ELinux/Course/assignments/yocto/assignment-6-Mostafa-elfallal/poky/meta \
  /home/fallal/ELinux/Course/assignments/yocto/assignment-6-Mostafa-elfallal/poky/meta-poky \
  /home/fallal/ELinux/Course/assignments/yocto/assignment-6-Mostafa-elfallal/poky/meta-yocto-bsp \
  "
```
